SECTIONS
{
    __romPos = 0;
    _gp = 0x0;
    header_ROM_START = __romPos;
    header_VRAM = ADDR(.header);
    .header : AT(header_ROM_START) SUBALIGN(16)
    {
        FILL(0x00000000);
        header_DATA_START = .;
        header = .;
        build/asm/header.o(.data);
        header_DATA_END = .;
        header_DATA_SIZE = ABSOLUTE(header_DATA_END - header_DATA_START);
    }
    __romPos += SIZEOF(.header);
    header_ROM_END = __romPos;
    header_VRAM_END = .;

    boot_ROM_START = __romPos;
    boot_VRAM = ADDR(.boot);
    .boot : AT(boot_ROM_START) SUBALIGN(16)
    {
        FILL(0x00000000);
        boot_DATA_START = .;
        boot = .;
        build/assets/boot.o(.data);
        boot_DATA_END = .;
        boot_DATA_SIZE = ABSOLUTE(boot_DATA_END - boot_DATA_START);
    }
    __romPos += SIZEOF(.boot);
    boot_ROM_END = __romPos;
    boot_VRAM_END = .;

    entry_ROM_START = __romPos;
    entry_VRAM = ADDR(.entry);
    .entry 0x8003AD80 : AT(entry_ROM_START) SUBALIGN(16)
    {
        FILL(0x00000000);
        entry_TEXT_START = .;
        build/asm/1000.o(.text);
        . = ALIGN(., 16);
        entry_TEXT_END = .;
        entry_TEXT_SIZE = ABSOLUTE(entry_TEXT_END - entry_TEXT_START);
        entry_DATA_START = .;
        _1000 = .;
        build/asm/1000.o(.data);
        . = ALIGN(., 16);
        entry_DATA_END = .;
        entry_DATA_SIZE = ABSOLUTE(entry_DATA_END - entry_DATA_START);
        entry_RODATA_START = .;
        build/asm/1000.o(.rodata);
        . = ALIGN(., 16);
        entry_RODATA_END = .;
        entry_RODATA_SIZE = ABSOLUTE(entry_RODATA_END - entry_RODATA_START);
    }
    entry_bss_VRAM = ADDR(.entry_bss);
    .entry_bss (NOLOAD) : SUBALIGN(16)
    {
        FILL(0x00000000);
        entry_BSS_START = .;
        build/asm/1000.o(.bss);
        . = ALIGN(., 16);
        entry_BSS_END = .;
        entry_BSS_SIZE = ABSOLUTE(entry_BSS_END - entry_BSS_START);
    }
    __romPos += SIZEOF(.entry);
    __romPos = ALIGN(__romPos, 16);
    . = ALIGN(., 16);
    entry_ROM_END = __romPos;
    entry_VRAM_END = .;

    main_ROM_START = __romPos;
    main_VRAM = ADDR(.main);
    .main entry_VRAM_END : AT(main_ROM_START) SUBALIGN(16)
    {
        FILL(0x00000000);
        main_TEXT_START = .;
        build/asm/1050.o(.text);
        build/asm/3E40.o(.text);
        build/asm/4460.o(.text);
        build/asm/5580.o(.text);
        build/asm/6780.o(.text);
        build/asm/6930.o(.text);
        build/asm/6B30.o(.text);
        build/asm/6BB0.o(.text);
        build/asm/73F0.o(.text);
        build/asm/74E0.o(.text);
        build/asm/8050.o(.text);
        build/asm/9A90.o(.text);
        build/asm/C0D0.o(.text);
        build/asm/C680.o(.text);
        build/asm/E2A0.o(.text);
        build/asm/10870.o(.text);
        build/asm/167A0.o(.text);
        build/asm/168D0.o(.text);
        build/asm/16C40.o(.text);
        build/asm/18D20.o(.text);
        build/asm/19780.o(.text);
        build/asm/1B150.o(.text);
        build/asm/1B280.o(.text);
        build/asm/1D300.o(.text);
        build/asm/1D6E0.o(.text);
        build/asm/24E90.o(.text);
        build/asm/25D00.o(.text);
        build/asm/26900.o(.text);
        build/asm/279C0.o(.text);
        build/asm/27BF0.o(.text);
        build/asm/2AF60.o(.text);
        build/asm/2B990.o(.text);
        build/asm/2CBA0.o(.text);
        build/asm/2E320.o(.text);
        build/asm/2F270.o(.text);
        build/asm/2FAB0.o(.text);
        build/asm/31630.o(.text);
        build/asm/32F00.o(.text);
        build/asm/33310.o(.text);
        build/asm/33430.o(.text);
        build/asm/33540.o(.text);
        build/asm/33640.o(.text);
        build/asm/354E0.o(.text);
        build/asm/37460.o(.text);
        build/asm/37700.o(.text);
        build/asm/379B0.o(.text);
        build/asm/38560.o(.text);
        build/asm/38580.o(.text);
        build/asm/38DB0.o(.text);
        build/asm/393B0.o(.text);
        build/asm/39E50.o(.text);
        build/asm/3A750.o(.text);
        build/asm/3AC20.o(.text);
        build/asm/3B700.o(.text);
        build/asm/3BB30.o(.text);
        build/asm/3C130.o(.text);
        build/asm/3C220.o(.text);
        build/asm/3D120.o(.text);
        build/asm/3D140.o(.text);
        build/asm/3D650.o(.text);
        build/asm/428D0.o(.text);
        build/asm/44240.o(.text);
        build/asm/46030.o(.text);
        build/asm/46770.o(.text);
        build/asm/46CF0.o(.text);
        build/asm/46DD0.o(.text);
        build/asm/470D0.o(.text);
        build/asm/471E0.o(.text);
        build/asm/49380.o(.text);
        build/asm/495A0.o(.text);
        build/asm/497E0.o(.text);
        build/asm/4A980.o(.text);
        build/asm/4BFD0.o(.text);
        build/asm/539F0.o(.text);
        build/asm/54910.o(.text);
        build/asm/55220.o(.text);
        build/asm/55500.o(.text);
        build/asm/63BC0.o(.text);
        build/asm/66700.o(.text);
        build/asm/691B0.o(.text);
        build/asm/69530.o(.text);
        build/asm/69580.o(.text);
        build/asm/697D0.o(.text);
        build/asm/69C30.o(.text);
        build/asm/69D80.o(.text);
        build/asm/6AE00.o(.text);
        build/asm/6F290.o(.text);
        build/asm/6FFD0.o(.text);
        build/asm/73120.o(.text);
        build/asm/73D50.o(.text);
        build/asm/74B00.o(.text);
        build/asm/77340.o(.text);
        build/asm/779F0.o(.text);
        build/asm/78FE0.o(.text);
        build/asm/79300.o(.text);
        build/asm/79330.o(.text);
        build/asm/793A0.o(.text);
        build/asm/796E0.o(.text);
        build/asm/798A0.o(.text);
        build/asm/79EA0.o(.text);
        build/asm/79FE0.o(.text);
        build/asm/7A1C0.o(.text);
        build/asm/7A270.o(.text);
        build/asm/7A640.o(.text);
        build/asm/7ACE0.o(.text);
        build/asm/7B160.o(.text);
        build/asm/7B310.o(.text);
        build/asm/7B580.o(.text);
        build/asm/7B880.o(.text);
        build/asm/7B8E0.o(.text);
        build/asm/7BA80.o(.text);
        build/asm/7BCA0.o(.text);
        build/asm/7BF70.o(.text);
        build/asm/7C3E0.o(.text);
        build/asm/7C5B0.o(.text);
        build/asm/7C770.o(.text);
        build/asm/7C7D0.o(.text);
        build/asm/7C860.o(.text);
        build/asm/7C8D0.o(.text);
        build/asm/7C900.o(.text);
        build/asm/7CBF0.o(.text);
        build/asm/7CCA0.o(.text);
        build/asm/7CD10.o(.text);
        build/asm/7D110.o(.text);
        build/asm/7D2E0.o(.text);
        build/asm/7D5F0.o(.text);
        build/asm/7D770.o(.text);
        build/asm/7DDC0.o(.text);
        build/asm/7E450.o(.text);
        build/asm/7E5C0.o(.text);
        build/asm/7E5D0.o(.text);
        build/asm/7E670.o(.text);
        build/asm/7E760.o(.text);
        build/asm/7E770.o(.text);
        build/asm/7E7B0.o(.text);
        build/asm/7E810.o(.text);
        build/asm/7E960.o(.text);
        build/asm/7EAA0.o(.text);
        build/asm/7EB50.o(.text);
        build/asm/7EB60.o(.text);
        build/asm/7EDE0.o(.text);
        build/asm/7EE60.o(.text);
        build/asm/7F040.o(.text);
        build/asm/7F130.o(.text);
        build/asm/7F1C0.o(.text);
        build/asm/7F960.o(.text);
        build/asm/7FA00.o(.text);
        build/asm/7FE50.o(.text);
        build/asm/7FF60.o(.text);
        build/asm/800C0.o(.text);
        build/asm/80260.o(.text);
        build/asm/80820.o(.text);
        build/asm/808E0.o(.text);
        build/asm/80970.o(.text);
        build/asm/81010.o(.text);
        build/asm/81220.o(.text);
        build/asm/812D0.o(.text);
        build/asm/813E0.o(.text);
        build/asm/81460.o(.text);
        build/asm/81540.o(.text);
        build/asm/81590.o(.text);
        build/asm/81750.o(.text);
        build/asm/81780.o(.text);
        build/asm/81800.o(.text);
        build/asm/818E0.o(.text);
        build/asm/81990.o(.text);
        build/asm/82580.o(.text);
        build/asm/82600.o(.text);
        build/asm/82830.o(.text);
        build/asm/833B0.o(.text);
        build/asm/83EC0.o(.text);
        build/asm/84110.o(.text);
        build/asm/84EA0.o(.text);
        build/asm/84FE0.o(.text);
        build/asm/853F0.o(.text);
        build/asm/85430.o(.text);
        build/asm/854C0.o(.text);
        build/asm/854F0.o(.text);
        build/asm/85520.o(.text);
        build/asm/85540.o(.text);
        build/asm/855F0.o(.text);
        build/asm/85670.o(.text);
        build/asm/856C0.o(.text);
        build/asm/85720.o(.text);
        build/asm/85780.o(.text);
        build/asm/85860.o(.text);
        build/asm/85FC0.o(.text);
        build/asm/862C0.o(.text);
        build/asm/862D0.o(.text);
        build/asm/862E0.o(.text);
        build/asm/863A0.o(.text);
        build/asm/863F0.o(.text);
        build/asm/87040.o(.text);
        build/asm/87B90.o(.text);
        build/asm/87DA0.o(.text);
        build/asm/87DD0.o(.text);
        build/asm/87EE0.o(.text);
        build/asm/884C0.o(.text);
        build/asm/88F80.o(.text);
        build/asm/88F90.o(.text);
        build/asm/88FC0.o(.text);
        build/asm/89020.o(.text);
        build/asm/89180.o(.text);
        build/asm/892E0.o(.text);
        build/asm/89330.o(.text);
        build/asm/89380.o(.text);
        build/asm/89400.o(.text);
        build/asm/89590.o(.text);
        . = ALIGN(., 16);
        main_TEXT_END = .;
        main_TEXT_SIZE = ABSOLUTE(main_TEXT_END - main_TEXT_START);
        main_DATA_START = .;
        _1050 = .;
        build/asm/1050.o(.data);
        _3E40 = .;
        build/asm/3E40.o(.data);
        _4460 = .;
        build/asm/4460.o(.data);
        _5580 = .;
        build/asm/5580.o(.data);
        _6780 = .;
        build/asm/6780.o(.data);
        _6930 = .;
        build/asm/6930.o(.data);
        _6B30 = .;
        build/asm/6B30.o(.data);
        _6BB0 = .;
        build/asm/6BB0.o(.data);
        _73F0 = .;
        build/asm/73F0.o(.data);
        _74E0 = .;
        build/asm/74E0.o(.data);
        _8050 = .;
        build/asm/8050.o(.data);
        _9A90 = .;
        build/asm/9A90.o(.data);
        C0D0 = .;
        build/asm/C0D0.o(.data);
        C680 = .;
        build/asm/C680.o(.data);
        E2A0 = .;
        build/asm/E2A0.o(.data);
        _10870 = .;
        build/asm/10870.o(.data);
        _167A0 = .;
        build/asm/167A0.o(.data);
        _168D0 = .;
        build/asm/168D0.o(.data);
        _16C40 = .;
        build/asm/16C40.o(.data);
        _18D20 = .;
        build/asm/18D20.o(.data);
        _19780 = .;
        build/asm/19780.o(.data);
        _1B150 = .;
        build/asm/1B150.o(.data);
        _1B280 = .;
        build/asm/1B280.o(.data);
        _1D300 = .;
        build/asm/1D300.o(.data);
        _1D6E0 = .;
        build/asm/1D6E0.o(.data);
        _24E90 = .;
        build/asm/24E90.o(.data);
        _25D00 = .;
        build/asm/25D00.o(.data);
        _26900 = .;
        build/asm/26900.o(.data);
        _279C0 = .;
        build/asm/279C0.o(.data);
        _27BF0 = .;
        build/asm/27BF0.o(.data);
        _2AF60 = .;
        build/asm/2AF60.o(.data);
        _2B990 = .;
        build/asm/2B990.o(.data);
        _2CBA0 = .;
        build/asm/2CBA0.o(.data);
        _2E320 = .;
        build/asm/2E320.o(.data);
        _2F270 = .;
        build/asm/2F270.o(.data);
        _2FAB0 = .;
        build/asm/2FAB0.o(.data);
        _31630 = .;
        build/asm/31630.o(.data);
        _32F00 = .;
        build/asm/32F00.o(.data);
        _33310 = .;
        build/asm/33310.o(.data);
        _33430 = .;
        build/asm/33430.o(.data);
        _33540 = .;
        build/asm/33540.o(.data);
        _33640 = .;
        build/asm/33640.o(.data);
        _354E0 = .;
        build/asm/354E0.o(.data);
        _37460 = .;
        build/asm/37460.o(.data);
        _37700 = .;
        build/asm/37700.o(.data);
        _379B0 = .;
        build/asm/379B0.o(.data);
        _38560 = .;
        build/asm/38560.o(.data);
        _38580 = .;
        build/asm/38580.o(.data);
        _38DB0 = .;
        build/asm/38DB0.o(.data);
        _393B0 = .;
        build/asm/393B0.o(.data);
        _39E50 = .;
        build/asm/39E50.o(.data);
        _3A750 = .;
        build/asm/3A750.o(.data);
        _3AC20 = .;
        build/asm/3AC20.o(.data);
        _3B700 = .;
        build/asm/3B700.o(.data);
        _3BB30 = .;
        build/asm/3BB30.o(.data);
        _3C130 = .;
        build/asm/3C130.o(.data);
        _3C220 = .;
        build/asm/3C220.o(.data);
        _3D120 = .;
        build/asm/3D120.o(.data);
        _3D140 = .;
        build/asm/3D140.o(.data);
        _3D650 = .;
        build/asm/3D650.o(.data);
        _428D0 = .;
        build/asm/428D0.o(.data);
        _44240 = .;
        build/asm/44240.o(.data);
        _46030 = .;
        build/asm/46030.o(.data);
        _46770 = .;
        build/asm/46770.o(.data);
        _46CF0 = .;
        build/asm/46CF0.o(.data);
        _46DD0 = .;
        build/asm/46DD0.o(.data);
        _470D0 = .;
        build/asm/470D0.o(.data);
        _471E0 = .;
        build/asm/471E0.o(.data);
        _49380 = .;
        build/asm/49380.o(.data);
        _495A0 = .;
        build/asm/495A0.o(.data);
        _497E0 = .;
        build/asm/497E0.o(.data);
        _4A980 = .;
        build/asm/4A980.o(.data);
        _4BFD0 = .;
        build/asm/4BFD0.o(.data);
        _539F0 = .;
        build/asm/539F0.o(.data);
        _54910 = .;
        build/asm/54910.o(.data);
        _55220 = .;
        build/asm/55220.o(.data);
        _55500 = .;
        build/asm/55500.o(.data);
        _63BC0 = .;
        build/asm/63BC0.o(.data);
        _66700 = .;
        build/asm/66700.o(.data);
        _691B0 = .;
        build/asm/691B0.o(.data);
        _69530 = .;
        build/asm/69530.o(.data);
        _69580 = .;
        build/asm/69580.o(.data);
        _697D0 = .;
        build/asm/697D0.o(.data);
        _69C30 = .;
        build/asm/69C30.o(.data);
        _69D80 = .;
        build/asm/69D80.o(.data);
        _6AE00 = .;
        build/asm/6AE00.o(.data);
        _6F290 = .;
        build/asm/6F290.o(.data);
        _6FFD0 = .;
        build/asm/6FFD0.o(.data);
        _73120 = .;
        build/asm/73120.o(.data);
        _73D50 = .;
        build/asm/73D50.o(.data);
        _74B00 = .;
        build/asm/74B00.o(.data);
        _77340 = .;
        build/asm/77340.o(.data);
        _779F0 = .;
        build/asm/779F0.o(.data);
        _78FE0 = .;
        build/asm/78FE0.o(.data);
        _79300 = .;
        build/asm/79300.o(.data);
        _79330 = .;
        build/asm/79330.o(.data);
        _793A0 = .;
        build/asm/793A0.o(.data);
        _796E0 = .;
        build/asm/796E0.o(.data);
        _798A0 = .;
        build/asm/798A0.o(.data);
        _79EA0 = .;
        build/asm/79EA0.o(.data);
        _79FE0 = .;
        build/asm/79FE0.o(.data);
        _7A1C0 = .;
        build/asm/7A1C0.o(.data);
        _7A270 = .;
        build/asm/7A270.o(.data);
        _7A640 = .;
        build/asm/7A640.o(.data);
        _7ACE0 = .;
        build/asm/7ACE0.o(.data);
        _7B160 = .;
        build/asm/7B160.o(.data);
        _7B310 = .;
        build/asm/7B310.o(.data);
        _7B580 = .;
        build/asm/7B580.o(.data);
        _7B880 = .;
        build/asm/7B880.o(.data);
        _7B8E0 = .;
        build/asm/7B8E0.o(.data);
        _7BA80 = .;
        build/asm/7BA80.o(.data);
        _7BCA0 = .;
        build/asm/7BCA0.o(.data);
        _7BF70 = .;
        build/asm/7BF70.o(.data);
        _7C3E0 = .;
        build/asm/7C3E0.o(.data);
        _7C5B0 = .;
        build/asm/7C5B0.o(.data);
        _7C770 = .;
        build/asm/7C770.o(.data);
        _7C7D0 = .;
        build/asm/7C7D0.o(.data);
        _7C860 = .;
        build/asm/7C860.o(.data);
        _7C8D0 = .;
        build/asm/7C8D0.o(.data);
        _7C900 = .;
        build/asm/7C900.o(.data);
        _7CBF0 = .;
        build/asm/7CBF0.o(.data);
        _7CCA0 = .;
        build/asm/7CCA0.o(.data);
        _7CD10 = .;
        build/asm/7CD10.o(.data);
        _7D110 = .;
        build/asm/7D110.o(.data);
        _7D2E0 = .;
        build/asm/7D2E0.o(.data);
        _7D5F0 = .;
        build/asm/7D5F0.o(.data);
        _7D770 = .;
        build/asm/7D770.o(.data);
        _7DDC0 = .;
        build/asm/7DDC0.o(.data);
        _7E450 = .;
        build/asm/7E450.o(.data);
        _7E5C0 = .;
        build/asm/7E5C0.o(.data);
        _7E5D0 = .;
        build/asm/7E5D0.o(.data);
        _7E670 = .;
        build/asm/7E670.o(.data);
        _7E760 = .;
        build/asm/7E760.o(.data);
        _7E770 = .;
        build/asm/7E770.o(.data);
        _7E7B0 = .;
        build/asm/7E7B0.o(.data);
        _7E810 = .;
        build/asm/7E810.o(.data);
        _7E960 = .;
        build/asm/7E960.o(.data);
        _7EAA0 = .;
        build/asm/7EAA0.o(.data);
        _7EB50 = .;
        build/asm/7EB50.o(.data);
        _7EB60 = .;
        build/asm/7EB60.o(.data);
        _7EDE0 = .;
        build/asm/7EDE0.o(.data);
        _7EE60 = .;
        build/asm/7EE60.o(.data);
        _7F040 = .;
        build/asm/7F040.o(.data);
        _7F130 = .;
        build/asm/7F130.o(.data);
        _7F1C0 = .;
        build/asm/7F1C0.o(.data);
        _7F960 = .;
        build/asm/7F960.o(.data);
        _7FA00 = .;
        build/asm/7FA00.o(.data);
        _7FE50 = .;
        build/asm/7FE50.o(.data);
        _7FF60 = .;
        build/asm/7FF60.o(.data);
        _800C0 = .;
        build/asm/800C0.o(.data);
        _80260 = .;
        build/asm/80260.o(.data);
        _80820 = .;
        build/asm/80820.o(.data);
        _808E0 = .;
        build/asm/808E0.o(.data);
        _80970 = .;
        build/asm/80970.o(.data);
        _81010 = .;
        build/asm/81010.o(.data);
        _81220 = .;
        build/asm/81220.o(.data);
        _812D0 = .;
        build/asm/812D0.o(.data);
        _813E0 = .;
        build/asm/813E0.o(.data);
        _81460 = .;
        build/asm/81460.o(.data);
        _81540 = .;
        build/asm/81540.o(.data);
        _81590 = .;
        build/asm/81590.o(.data);
        _81750 = .;
        build/asm/81750.o(.data);
        _81780 = .;
        build/asm/81780.o(.data);
        _81800 = .;
        build/asm/81800.o(.data);
        _818E0 = .;
        build/asm/818E0.o(.data);
        _81990 = .;
        build/asm/81990.o(.data);
        _82580 = .;
        build/asm/82580.o(.data);
        _82600 = .;
        build/asm/82600.o(.data);
        _82830 = .;
        build/asm/82830.o(.data);
        _833B0 = .;
        build/asm/833B0.o(.data);
        _83EC0 = .;
        build/asm/83EC0.o(.data);
        _84110 = .;
        build/asm/84110.o(.data);
        _84EA0 = .;
        build/asm/84EA0.o(.data);
        _84FE0 = .;
        build/asm/84FE0.o(.data);
        _853F0 = .;
        build/asm/853F0.o(.data);
        _85430 = .;
        build/asm/85430.o(.data);
        _854C0 = .;
        build/asm/854C0.o(.data);
        _854F0 = .;
        build/asm/854F0.o(.data);
        _85520 = .;
        build/asm/85520.o(.data);
        _85540 = .;
        build/asm/85540.o(.data);
        _855F0 = .;
        build/asm/855F0.o(.data);
        _85670 = .;
        build/asm/85670.o(.data);
        _856C0 = .;
        build/asm/856C0.o(.data);
        _85720 = .;
        build/asm/85720.o(.data);
        _85780 = .;
        build/asm/85780.o(.data);
        _85860 = .;
        build/asm/85860.o(.data);
        _85FC0 = .;
        build/asm/85FC0.o(.data);
        _862C0 = .;
        build/asm/862C0.o(.data);
        _862D0 = .;
        build/asm/862D0.o(.data);
        _862E0 = .;
        build/asm/862E0.o(.data);
        _863A0 = .;
        build/asm/863A0.o(.data);
        _863F0 = .;
        build/asm/863F0.o(.data);
        _87040 = .;
        build/asm/87040.o(.data);
        _87B90 = .;
        build/asm/87B90.o(.data);
        _87DA0 = .;
        build/asm/87DA0.o(.data);
        _87DD0 = .;
        build/asm/87DD0.o(.data);
        _87EE0 = .;
        build/asm/87EE0.o(.data);
        _884C0 = .;
        build/asm/884C0.o(.data);
        _88F80 = .;
        build/asm/88F80.o(.data);
        _88F90 = .;
        build/asm/88F90.o(.data);
        _88FC0 = .;
        build/asm/88FC0.o(.data);
        _89020 = .;
        build/asm/89020.o(.data);
        _89180 = .;
        build/asm/89180.o(.data);
        _892E0 = .;
        build/asm/892E0.o(.data);
        _89330 = .;
        build/asm/89330.o(.data);
        _89380 = .;
        build/asm/89380.o(.data);
        _89400 = .;
        build/asm/89400.o(.data);
        _89590 = .;
        build/asm/89590.o(.data);
        _895E0_data = .;
        build/asm/data/895E0.data.o(.data);
        . = ALIGN(., 16);
        main_DATA_END = .;
        main_DATA_SIZE = ABSOLUTE(main_DATA_END - main_DATA_START);
        main_RODATA_START = .;
        build/asm/1050.o(.rodata);
        build/asm/3E40.o(.rodata);
        build/asm/4460.o(.rodata);
        build/asm/5580.o(.rodata);
        build/asm/6780.o(.rodata);
        build/asm/6930.o(.rodata);
        build/asm/6B30.o(.rodata);
        build/asm/6BB0.o(.rodata);
        build/asm/73F0.o(.rodata);
        build/asm/74E0.o(.rodata);
        build/asm/8050.o(.rodata);
        build/asm/9A90.o(.rodata);
        build/asm/C0D0.o(.rodata);
        build/asm/C680.o(.rodata);
        build/asm/E2A0.o(.rodata);
        build/asm/10870.o(.rodata);
        build/asm/167A0.o(.rodata);
        build/asm/168D0.o(.rodata);
        build/asm/16C40.o(.rodata);
        build/asm/18D20.o(.rodata);
        build/asm/19780.o(.rodata);
        build/asm/1B150.o(.rodata);
        build/asm/1B280.o(.rodata);
        build/asm/1D300.o(.rodata);
        build/asm/1D6E0.o(.rodata);
        build/asm/24E90.o(.rodata);
        build/asm/25D00.o(.rodata);
        build/asm/26900.o(.rodata);
        build/asm/279C0.o(.rodata);
        build/asm/27BF0.o(.rodata);
        build/asm/2AF60.o(.rodata);
        build/asm/2B990.o(.rodata);
        build/asm/2CBA0.o(.rodata);
        build/asm/2E320.o(.rodata);
        build/asm/2F270.o(.rodata);
        build/asm/2FAB0.o(.rodata);
        build/asm/31630.o(.rodata);
        build/asm/32F00.o(.rodata);
        build/asm/33310.o(.rodata);
        build/asm/33430.o(.rodata);
        build/asm/33540.o(.rodata);
        build/asm/33640.o(.rodata);
        build/asm/354E0.o(.rodata);
        build/asm/37460.o(.rodata);
        build/asm/37700.o(.rodata);
        build/asm/379B0.o(.rodata);
        build/asm/38560.o(.rodata);
        build/asm/38580.o(.rodata);
        build/asm/38DB0.o(.rodata);
        build/asm/393B0.o(.rodata);
        build/asm/39E50.o(.rodata);
        build/asm/3A750.o(.rodata);
        build/asm/3AC20.o(.rodata);
        build/asm/3B700.o(.rodata);
        build/asm/3BB30.o(.rodata);
        build/asm/3C130.o(.rodata);
        build/asm/3C220.o(.rodata);
        build/asm/3D120.o(.rodata);
        build/asm/3D140.o(.rodata);
        build/asm/3D650.o(.rodata);
        build/asm/428D0.o(.rodata);
        build/asm/44240.o(.rodata);
        build/asm/46030.o(.rodata);
        build/asm/46770.o(.rodata);
        build/asm/46CF0.o(.rodata);
        build/asm/46DD0.o(.rodata);
        build/asm/470D0.o(.rodata);
        build/asm/471E0.o(.rodata);
        build/asm/49380.o(.rodata);
        build/asm/495A0.o(.rodata);
        build/asm/497E0.o(.rodata);
        build/asm/4A980.o(.rodata);
        build/asm/4BFD0.o(.rodata);
        build/asm/539F0.o(.rodata);
        build/asm/54910.o(.rodata);
        build/asm/55220.o(.rodata);
        build/asm/55500.o(.rodata);
        build/asm/63BC0.o(.rodata);
        build/asm/66700.o(.rodata);
        build/asm/691B0.o(.rodata);
        build/asm/69530.o(.rodata);
        build/asm/69580.o(.rodata);
        build/asm/697D0.o(.rodata);
        build/asm/69C30.o(.rodata);
        build/asm/69D80.o(.rodata);
        build/asm/6AE00.o(.rodata);
        build/asm/6F290.o(.rodata);
        build/asm/6FFD0.o(.rodata);
        build/asm/73120.o(.rodata);
        build/asm/73D50.o(.rodata);
        build/asm/74B00.o(.rodata);
        build/asm/77340.o(.rodata);
        build/asm/779F0.o(.rodata);
        build/asm/78FE0.o(.rodata);
        build/asm/79300.o(.rodata);
        build/asm/79330.o(.rodata);
        build/asm/793A0.o(.rodata);
        build/asm/796E0.o(.rodata);
        build/asm/798A0.o(.rodata);
        build/asm/79EA0.o(.rodata);
        build/asm/79FE0.o(.rodata);
        build/asm/7A1C0.o(.rodata);
        build/asm/7A270.o(.rodata);
        build/asm/7A640.o(.rodata);
        build/asm/7ACE0.o(.rodata);
        build/asm/7B160.o(.rodata);
        build/asm/7B310.o(.rodata);
        build/asm/7B580.o(.rodata);
        build/asm/7B880.o(.rodata);
        build/asm/7B8E0.o(.rodata);
        build/asm/7BA80.o(.rodata);
        build/asm/7BCA0.o(.rodata);
        build/asm/7BF70.o(.rodata);
        build/asm/7C3E0.o(.rodata);
        build/asm/7C5B0.o(.rodata);
        build/asm/7C770.o(.rodata);
        build/asm/7C7D0.o(.rodata);
        build/asm/7C860.o(.rodata);
        build/asm/7C8D0.o(.rodata);
        build/asm/7C900.o(.rodata);
        build/asm/7CBF0.o(.rodata);
        build/asm/7CCA0.o(.rodata);
        build/asm/7CD10.o(.rodata);
        build/asm/7D110.o(.rodata);
        build/asm/7D2E0.o(.rodata);
        build/asm/7D5F0.o(.rodata);
        build/asm/7D770.o(.rodata);
        build/asm/7DDC0.o(.rodata);
        build/asm/7E450.o(.rodata);
        build/asm/7E5C0.o(.rodata);
        build/asm/7E5D0.o(.rodata);
        build/asm/7E670.o(.rodata);
        build/asm/7E760.o(.rodata);
        build/asm/7E770.o(.rodata);
        build/asm/7E7B0.o(.rodata);
        build/asm/7E810.o(.rodata);
        build/asm/7E960.o(.rodata);
        build/asm/7EAA0.o(.rodata);
        build/asm/7EB50.o(.rodata);
        build/asm/7EB60.o(.rodata);
        build/asm/7EDE0.o(.rodata);
        build/asm/7EE60.o(.rodata);
        build/asm/7F040.o(.rodata);
        build/asm/7F130.o(.rodata);
        build/asm/7F1C0.o(.rodata);
        build/asm/7F960.o(.rodata);
        build/asm/7FA00.o(.rodata);
        build/asm/7FE50.o(.rodata);
        build/asm/7FF60.o(.rodata);
        build/asm/800C0.o(.rodata);
        build/asm/80260.o(.rodata);
        build/asm/80820.o(.rodata);
        build/asm/808E0.o(.rodata);
        build/asm/80970.o(.rodata);
        build/asm/81010.o(.rodata);
        build/asm/81220.o(.rodata);
        build/asm/812D0.o(.rodata);
        build/asm/813E0.o(.rodata);
        build/asm/81460.o(.rodata);
        build/asm/81540.o(.rodata);
        build/asm/81590.o(.rodata);
        build/asm/81750.o(.rodata);
        build/asm/81780.o(.rodata);
        build/asm/81800.o(.rodata);
        build/asm/818E0.o(.rodata);
        build/asm/81990.o(.rodata);
        build/asm/82580.o(.rodata);
        build/asm/82600.o(.rodata);
        build/asm/82830.o(.rodata);
        build/asm/833B0.o(.rodata);
        build/asm/83EC0.o(.rodata);
        build/asm/84110.o(.rodata);
        build/asm/84EA0.o(.rodata);
        build/asm/84FE0.o(.rodata);
        build/asm/853F0.o(.rodata);
        build/asm/85430.o(.rodata);
        build/asm/854C0.o(.rodata);
        build/asm/854F0.o(.rodata);
        build/asm/85520.o(.rodata);
        build/asm/85540.o(.rodata);
        build/asm/855F0.o(.rodata);
        build/asm/85670.o(.rodata);
        build/asm/856C0.o(.rodata);
        build/asm/85720.o(.rodata);
        build/asm/85780.o(.rodata);
        build/asm/85860.o(.rodata);
        build/asm/85FC0.o(.rodata);
        build/asm/862C0.o(.rodata);
        build/asm/862D0.o(.rodata);
        build/asm/862E0.o(.rodata);
        build/asm/863A0.o(.rodata);
        build/asm/863F0.o(.rodata);
        build/asm/87040.o(.rodata);
        build/asm/87B90.o(.rodata);
        build/asm/87DA0.o(.rodata);
        build/asm/87DD0.o(.rodata);
        build/asm/87EE0.o(.rodata);
        build/asm/884C0.o(.rodata);
        build/asm/88F80.o(.rodata);
        build/asm/88F90.o(.rodata);
        build/asm/88FC0.o(.rodata);
        build/asm/89020.o(.rodata);
        build/asm/89180.o(.rodata);
        build/asm/892E0.o(.rodata);
        build/asm/89330.o(.rodata);
        build/asm/89380.o(.rodata);
        build/asm/89400.o(.rodata);
        build/asm/89590.o(.rodata);
        . = ALIGN(., 16);
        main_RODATA_END = .;
        main_RODATA_SIZE = ABSOLUTE(main_RODATA_END - main_RODATA_START);
    }
    main_bss_VRAM = ADDR(.main_bss);
    .main_bss (NOLOAD) : SUBALIGN(16)
    {
        FILL(0x00000000);
        main_BSS_START = .;
        build/asm/1050.o(.bss);
        build/asm/3E40.o(.bss);
        build/asm/4460.o(.bss);
        build/asm/5580.o(.bss);
        build/asm/6780.o(.bss);
        build/asm/6930.o(.bss);
        build/asm/6B30.o(.bss);
        build/asm/6BB0.o(.bss);
        build/asm/73F0.o(.bss);
        build/asm/74E0.o(.bss);
        build/asm/8050.o(.bss);
        build/asm/9A90.o(.bss);
        build/asm/C0D0.o(.bss);
        build/asm/C680.o(.bss);
        build/asm/E2A0.o(.bss);
        build/asm/10870.o(.bss);
        build/asm/167A0.o(.bss);
        build/asm/168D0.o(.bss);
        build/asm/16C40.o(.bss);
        build/asm/18D20.o(.bss);
        build/asm/19780.o(.bss);
        build/asm/1B150.o(.bss);
        build/asm/1B280.o(.bss);
        build/asm/1D300.o(.bss);
        build/asm/1D6E0.o(.bss);
        build/asm/24E90.o(.bss);
        build/asm/25D00.o(.bss);
        build/asm/26900.o(.bss);
        build/asm/279C0.o(.bss);
        build/asm/27BF0.o(.bss);
        build/asm/2AF60.o(.bss);
        build/asm/2B990.o(.bss);
        build/asm/2CBA0.o(.bss);
        build/asm/2E320.o(.bss);
        build/asm/2F270.o(.bss);
        build/asm/2FAB0.o(.bss);
        build/asm/31630.o(.bss);
        build/asm/32F00.o(.bss);
        build/asm/33310.o(.bss);
        build/asm/33430.o(.bss);
        build/asm/33540.o(.bss);
        build/asm/33640.o(.bss);
        build/asm/354E0.o(.bss);
        build/asm/37460.o(.bss);
        build/asm/37700.o(.bss);
        build/asm/379B0.o(.bss);
        build/asm/38560.o(.bss);
        build/asm/38580.o(.bss);
        build/asm/38DB0.o(.bss);
        build/asm/393B0.o(.bss);
        build/asm/39E50.o(.bss);
        build/asm/3A750.o(.bss);
        build/asm/3AC20.o(.bss);
        build/asm/3B700.o(.bss);
        build/asm/3BB30.o(.bss);
        build/asm/3C130.o(.bss);
        build/asm/3C220.o(.bss);
        build/asm/3D120.o(.bss);
        build/asm/3D140.o(.bss);
        build/asm/3D650.o(.bss);
        build/asm/428D0.o(.bss);
        build/asm/44240.o(.bss);
        build/asm/46030.o(.bss);
        build/asm/46770.o(.bss);
        build/asm/46CF0.o(.bss);
        build/asm/46DD0.o(.bss);
        build/asm/470D0.o(.bss);
        build/asm/471E0.o(.bss);
        build/asm/49380.o(.bss);
        build/asm/495A0.o(.bss);
        build/asm/497E0.o(.bss);
        build/asm/4A980.o(.bss);
        build/asm/4BFD0.o(.bss);
        build/asm/539F0.o(.bss);
        build/asm/54910.o(.bss);
        build/asm/55220.o(.bss);
        build/asm/55500.o(.bss);
        build/asm/63BC0.o(.bss);
        build/asm/66700.o(.bss);
        build/asm/691B0.o(.bss);
        build/asm/69530.o(.bss);
        build/asm/69580.o(.bss);
        build/asm/697D0.o(.bss);
        build/asm/69C30.o(.bss);
        build/asm/69D80.o(.bss);
        build/asm/6AE00.o(.bss);
        build/asm/6F290.o(.bss);
        build/asm/6FFD0.o(.bss);
        build/asm/73120.o(.bss);
        build/asm/73D50.o(.bss);
        build/asm/74B00.o(.bss);
        build/asm/77340.o(.bss);
        build/asm/779F0.o(.bss);
        build/asm/78FE0.o(.bss);
        build/asm/79300.o(.bss);
        build/asm/79330.o(.bss);
        build/asm/793A0.o(.bss);
        build/asm/796E0.o(.bss);
        build/asm/798A0.o(.bss);
        build/asm/79EA0.o(.bss);
        build/asm/79FE0.o(.bss);
        build/asm/7A1C0.o(.bss);
        build/asm/7A270.o(.bss);
        build/asm/7A640.o(.bss);
        build/asm/7ACE0.o(.bss);
        build/asm/7B160.o(.bss);
        build/asm/7B310.o(.bss);
        build/asm/7B580.o(.bss);
        build/asm/7B880.o(.bss);
        build/asm/7B8E0.o(.bss);
        build/asm/7BA80.o(.bss);
        build/asm/7BCA0.o(.bss);
        build/asm/7BF70.o(.bss);
        build/asm/7C3E0.o(.bss);
        build/asm/7C5B0.o(.bss);
        build/asm/7C770.o(.bss);
        build/asm/7C7D0.o(.bss);
        build/asm/7C860.o(.bss);
        build/asm/7C8D0.o(.bss);
        build/asm/7C900.o(.bss);
        build/asm/7CBF0.o(.bss);
        build/asm/7CCA0.o(.bss);
        build/asm/7CD10.o(.bss);
        build/asm/7D110.o(.bss);
        build/asm/7D2E0.o(.bss);
        build/asm/7D5F0.o(.bss);
        build/asm/7D770.o(.bss);
        build/asm/7DDC0.o(.bss);
        build/asm/7E450.o(.bss);
        build/asm/7E5C0.o(.bss);
        build/asm/7E5D0.o(.bss);
        build/asm/7E670.o(.bss);
        build/asm/7E760.o(.bss);
        build/asm/7E770.o(.bss);
        build/asm/7E7B0.o(.bss);
        build/asm/7E810.o(.bss);
        build/asm/7E960.o(.bss);
        build/asm/7EAA0.o(.bss);
        build/asm/7EB50.o(.bss);
        build/asm/7EB60.o(.bss);
        build/asm/7EDE0.o(.bss);
        build/asm/7EE60.o(.bss);
        build/asm/7F040.o(.bss);
        build/asm/7F130.o(.bss);
        build/asm/7F1C0.o(.bss);
        build/asm/7F960.o(.bss);
        build/asm/7FA00.o(.bss);
        build/asm/7FE50.o(.bss);
        build/asm/7FF60.o(.bss);
        build/asm/800C0.o(.bss);
        build/asm/80260.o(.bss);
        build/asm/80820.o(.bss);
        build/asm/808E0.o(.bss);
        build/asm/80970.o(.bss);
        build/asm/81010.o(.bss);
        build/asm/81220.o(.bss);
        build/asm/812D0.o(.bss);
        build/asm/813E0.o(.bss);
        build/asm/81460.o(.bss);
        build/asm/81540.o(.bss);
        build/asm/81590.o(.bss);
        build/asm/81750.o(.bss);
        build/asm/81780.o(.bss);
        build/asm/81800.o(.bss);
        build/asm/818E0.o(.bss);
        build/asm/81990.o(.bss);
        build/asm/82580.o(.bss);
        build/asm/82600.o(.bss);
        build/asm/82830.o(.bss);
        build/asm/833B0.o(.bss);
        build/asm/83EC0.o(.bss);
        build/asm/84110.o(.bss);
        build/asm/84EA0.o(.bss);
        build/asm/84FE0.o(.bss);
        build/asm/853F0.o(.bss);
        build/asm/85430.o(.bss);
        build/asm/854C0.o(.bss);
        build/asm/854F0.o(.bss);
        build/asm/85520.o(.bss);
        build/asm/85540.o(.bss);
        build/asm/855F0.o(.bss);
        build/asm/85670.o(.bss);
        build/asm/856C0.o(.bss);
        build/asm/85720.o(.bss);
        build/asm/85780.o(.bss);
        build/asm/85860.o(.bss);
        build/asm/85FC0.o(.bss);
        build/asm/862C0.o(.bss);
        build/asm/862D0.o(.bss);
        build/asm/862E0.o(.bss);
        build/asm/863A0.o(.bss);
        build/asm/863F0.o(.bss);
        build/asm/87040.o(.bss);
        build/asm/87B90.o(.bss);
        build/asm/87DA0.o(.bss);
        build/asm/87DD0.o(.bss);
        build/asm/87EE0.o(.bss);
        build/asm/884C0.o(.bss);
        build/asm/88F80.o(.bss);
        build/asm/88F90.o(.bss);
        build/asm/88FC0.o(.bss);
        build/asm/89020.o(.bss);
        build/asm/89180.o(.bss);
        build/asm/892E0.o(.bss);
        build/asm/89330.o(.bss);
        build/asm/89380.o(.bss);
        build/asm/89400.o(.bss);
        build/asm/89590.o(.bss);
        build/asm/data/A8190.bss.o(.bss);
        . = ALIGN(., 16);
        main_BSS_END = .;
        main_BSS_SIZE = ABSOLUTE(main_BSS_END - main_BSS_START);
    }
    __romPos += SIZEOF(.main);
    __romPos = ALIGN(__romPos, 16);
    . = ALIGN(., 16);
    main_ROM_END = __romPos;
    main_VRAM_END = .;

    A8190_ROM_START = __romPos;
    A8190_VRAM = ADDR(.A8190);
    .A8190 main_VRAM_END : AT(A8190_ROM_START) SUBALIGN(16)
    {
        FILL(0x00000000);
        A8190_DATA_START = .;
        A8190 = .;
        build/assets/A8190.o(.data);
        A8190_DATA_END = .;
        A8190_DATA_SIZE = ABSOLUTE(A8190_DATA_END - A8190_DATA_START);
    }
    __romPos += SIZEOF(.A8190);
    A8190_ROM_END = __romPos;
    A8190_VRAM_END = .;

    /DISCARD/ :
    {
        *(*);
    }
}
